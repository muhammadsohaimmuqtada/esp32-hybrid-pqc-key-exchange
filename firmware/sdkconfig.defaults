## firmware/sdkconfig.defaults
```kconfig
# ESP32 Hybrid PQC - sdkconfig defaults
# mbedTLS configuration for X25519 + HKDF + AES-GCM

# Enable X25519 / Curve25519
CONFIG_MBEDTLS_ECDH_C=y
CONFIG_MBEDTLS_ECP_DP_CURVE25519_ENABLED=y
CONFIG_MBEDTLS_KEY_EXCHANGE_ECDHE_RSA=y

# Enable HKDF
CONFIG_MBEDTLS_HKDF_C=y

# Enable AES-GCM with hardware acceleration
CONFIG_MBEDTLS_GCM_C=y
CONFIG_MBEDTLS_HARDWARE_AES=y

# SHA-256 for HKDF
CONFIG_MBEDTLS_HARDWARE_SHA=y

# Enable TLS 1.3
CONFIG_MBEDTLS_SSL_PROTO_TLS1_3=y

# Increase mbedTLS memory for ML-KEM operations
CONFIG_MBEDTLS_DYNAMIC_BUFFER=y
CONFIG_MBEDTLS_SSL_MAX_CONTENT_LEN=4096

# Wi-Fi
CONFIG_ESP_WIFI_SSID="REPLACE_WITH_YOUR_SSID"
CONFIG_ESP_WIFI_PASSWORD="REPLACE_WITH_YOUR_PASSWORD"
CONFIG_ESP_MAXIMUM_RETRY=10

# FreeRTOS
CONFIG_FREERTOS_HZ=1000
CONFIG_FREERTOS_UNICORE=n

# System
CONFIG_ESP_SYSTEM_EVENT_TASK_STACK_SIZE=4096
CONFIG_ESP_MAIN_TASK_STACK_SIZE=8192

# HTTP Client
CONFIG_ESP_HTTP_CLIENT_ENABLE_HTTPS=y

# Target
CONFIG_IDF_TARGET="esp32"

# Flash size
CONFIG_ESPTOOLPY_FLASHSIZE_4MB=y

# Partition table
CONFIG_PARTITION_TABLE_SINGLE_APP=y

# Optimization
CONFIG_COMPILER_OPTIMIZATION_PERF=y
```
